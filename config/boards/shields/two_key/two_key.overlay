#include <dt-bindings/zmk/matrix_transform.h>

/ {
    chosen {
        zmk,kscan = &kscan0;
        zmk,matrix-transform = &default_transform;
    };

    kscan0: kscan {
        compatible = "zmk,kscan-gpio-direct";
        input-gpios = <&xiao_d 0 (GPIO_ACTIVE_LOW | GPIO_PULL_UP)>,
                       <&xiao_d 1 (GPIO_ACTIVE_LOW | GPIO_PULL_UP)>;
        debounce-press-ms = <5>;
        debounce-release-ms = <5>;
    };

    default_transform: keymap_transform {
        compatible = "zmk,matrix-transform";
        columns = <2>;
        rows = <1>;
        map = <RC(0, 0) RC(0, 1)>;
    };
};
