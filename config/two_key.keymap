#include <behaviors.dtsi>
#include <dt-bindings/zmk/keys.h>

/ {
    keymap {
        compatible = "zmk,keymap";

        default_layer {
            display-name = "Copy Paste";
            bindings = <
                &kp LC(C)
                &kp LC(V)
            >;
        };
    };
};
